// ARC-1 Compact R8.5 -- system-level RTL testbench for arc1_ecp5_top (LFE5U-45F).
// Derived from R08_WORK/fpga/tb/tb_top_r08.sv: every R08 check is kept (ident, buffer
// integrity, CS abort, R05 golden loopback, doorbell rules, BIST, recover, FPGA reset,
// P0-P4) with VERSION/CAPS updated for AMBX v3, plus R8.5 AJOB cross-simulation:
//   J0..J10 request frames + expected responses generated by the F133 C driver and the
//   R05 C reference (firmware/tools/ajob_vectors.c), compared byte for byte, RTL bytes
//   dumped for the host-parser second pass; error injection: bad CRC/version/opcode/
//   length, count 0/171; ABORT mid-batch; perf counters; FPGA loss (PLL unlock) mid-job.
// R08 PSRAM power-domain scenarios kept:
//   P0 PSRAM unpowered at start: no PSRAM pad high (no back-power), not ready
//   P1 controlled power-up: during tPU CE# = VDD (high), CLK low, SIO low
//   P2 commanded power-off during BIST (EN falls first): job fails, POWER_LOST
//      sticky, READY withheld until CLEAR, no back-power once EN is low
//   P3 PG glitch (1 sys clock): treated as a full power loss (fail-safe)
//   P4 unannounced rail loss with EN still high (load-switch fault): detected via
//      PG; the back-power window before detection is MEASURED and reported
// The R07 power-aware APS6404L model is used. RTL SIMULATION ONLY.
`timescale 1ns/1ps
module tb_ecp5_top;
    parameter real SYS_NS   = 12.5;   // 80 MHz
    parameter real MEM_NS   = 25.0;   // 40 MHz -> SCLK 20 MHz
    parameter      GOLD_DIR = "build";
    parameter      AJOB_DIR = "build/ajob";
    `include "golden_frames.svh"
    `include "ajob_cases.svh"

    // clocks come from the behavioural PLL model inside the DUT; lock is forced by the tb
    reg  pll_locked = 0, clk_25m = 0;
    always #20 clk_25m = ~clk_25m;
    wire sys_clk = dut.sys_clk;
    initial force dut.u_pll.locked = pll_locked;     // continuous force tracks pll_locked

    // ---------------- pads ----------------
    reg  sck = 0, ss_n = 1, mosi = 0;
    wire spi_miso, irq_n_pad, miso_pad;
    pulldown (weak0) pd_fpga_miso (spi_miso);         // ECP5 weak pull-down (unconfigured / tri-stated)
    assign miso_pad = ss_n ? 1'bz : spi_miso;          // SN74LVC1G125, OE# = FPGA CS
    pulldown (weak0) pd_miso (miso_pad);              // 3.3k BOOT-SEL1 strap pull-down (strap 00)
    pullup (weak1) pu_irq (irq_n_pad);                // 10k board pull-up
    wire       sclk;
    wire       ce_pad;
    reg        vdd = 1'b0;        // switched PSRAM_VDD (load switch output)
    reg        en  = 1'b0;        // load-switch EN = F133 PSRAM_PWR_REQ & FPGA DONE (delayed)
    reg        pg  = 1'b0;        // supervisor output (open drain + pull-up)
    reg        pg_glitch_n = 1'b1;
    assign (weak1, weak0) ce_pad = vdd;                // 10k pull-up to PSRAM_VDD
    wire [3:0] sio;
    genvar g;
    generate for (g = 0; g < 4; g = g + 1) begin : g_sio
        pulldown (weak0) pd (sio[g]);                // 100k static pull-downs
    end endgenerate
    wire led, dbg_tx;
    wire [3:0] sio_oe = dut.p_dq_oe;

    arc1_ecp5_top #(.SYS_HZ(80000000), .MCLK_HZ(40000000), .BIST_BLOCKS(64)) dut (
        .clk_25m(clk_25m),
        .spi_sck(sck), .spi_cs_n(ss_n), .spi_mosi(mosi), .spi_miso(spi_miso), .irq_n(irq_n_pad),
        .psram_ce_n(ce_pad), .psram_sclk(sclk), .psram_sio(sio),
        .psram_pg(pg & pg_glitch_n), .psram_pwr_en(en),
        .led(led), .dbg_tx(dbg_tx), .dbg_rx(1'b1));

    // The model represents a powered device: while VDD is off it sees CE# high and CLK low;
    // the pads themselves are checked by the monitors below.
    wire m_ce = vdd ? ce_pad : 1'b1;
    wire m_ck = vdd ? sclk   : 1'b0;
    aps6404l_model_r07 psram (.ce_n(m_ce), .sclk(m_ck), .sio(sio));

    // ---------------- PSRAM power-domain monitors ----------------
    localparam real TPU_NS = 150000.0;
    real    t_vdd_up = -1.0e12;
    integer bp_en_low = 0, bp_en_high_ns = 0, tpu_pin_viol = 0;
    real    t_bp_start;
    reg     bp_active = 1'b0;
    wire    any_high = (ce_pad === 1'b1) || (sclk === 1'b1) || (sio[0] === 1'b1) || (sio[1] === 1'b1)
                    || (sio[2] === 1'b1) || (sio[3] === 1'b1);
    // back-power: any PSRAM pad high while its VDD is off
    // Evaluated 1 ns after each change so that nets driven from vdd (the CE# pull-up)
    // have settled; pad edges are >= 12.5 ns apart, so no event is lost.
    always @(any_high or vdd or en) begin
        #1;
        if (!vdd && any_high && !bp_active) begin bp_active = 1'b1; t_bp_start = $realtime;
            if (!en) begin bp_en_low = bp_en_low + 1;
                $display("TB_ERROR t=%0t back-power with EN low (ce=%b sclk=%b sio=%b)", $realtime, ce_pad, sclk, sio); end
        end
        if (bp_active && (vdd || !any_high)) begin bp_active = 1'b0;
            bp_en_high_ns = bp_en_high_ns + $rtoi($realtime - t_bp_start); end
    end
    // tPU pin states (APS6404L DS Rev 2.7 s.8): CE# high, CLK low, SIO low
    always @(posedge vdd) t_vdd_up = $realtime;
    always @(ce_pad or sclk or sio or vdd)
        if (vdd && ($realtime - t_vdd_up) < TPU_NS && ($realtime > t_vdd_up))
            if (ce_pad !== 1'b1 || sclk !== 1'b0 || sio !== 4'b0000) begin
                tpu_pin_viol = tpu_pin_viol + 1;
                $display("TB_ERROR t=%0t tPU pin state ce=%b sclk=%b sio=%b", $realtime, ce_pad, sclk, sio);
            end
    task automatic psram_on;   // F133 raises PSRAM_PWR_REQ with CDONE high
        begin en = 1; #2000; vdd = 1; psram.inject_dead = 0; psram.power_cycle; #10000; pg = 1; end
    endtask
    task automatic psram_off_commanded;
        begin en = 0; #3000; pg = 0; #2000; vdd = 0; psram.inject_dead = 1; end
    endtask

    // ---------------- checks ----------------
    integer errors = 0;
    task automatic fail(input [8*72-1:0] m);
        begin errors = errors + 1; $display("TB_ERROR t=%0t %0s", $realtime, m); end
    endtask
    reg     ce_stuck_inj = 1'b0;
    integer contention_during_inj = 0;
    always @(sio_oe or psram.doe) if (vdd && |(sio_oe & psram.doe)) begin
        if (ce_stuck_inj) contention_during_inj = contention_during_inj + 1;   // expected hazard while CE# is shorted
        else fail("PSRAM bus contention");
    end

    // MISO must be released whenever SS_N is high (checked 4 sys clocks after)
    always @(posedge ss_n) begin
        repeat (4) @(posedge sys_clk);
        if (ss_n && dut.miso_oe) fail("MISO driven while SS_N high");
    end

    // ---------------- SPI master (F133 model) ----------------
    real    hp = 50.0;                  // SCK half period
    reg [7:0] tx [0:8199];
    reg [7:0] rx [0:8199];
    task automatic spi(input integer n);
        integer i, b;
        begin
            ss_n = 0; #(2 * hp);         // F133 ts(cs) = 2T
            for (i = 0; i < n; i = i + 1)
                for (b = 7; b >= 0; b = b - 1) begin
                    mosi = tx[i][b];
                    #(hp); sck = 1;
                    rx[i][b] = miso_pad;
                    #(hp); sck = 0;
                end
            #(2 * hp); ss_n = 1; #(4 * hp);
        end
    endtask
    reg [7:0] payload [0:8191];
    task automatic write_mem(input [15:0] a, input integer n);
        integer i;
        begin
            tx[0] = 8'h02; tx[1] = a[15:8]; tx[2] = a[7:0];
            for (i = 0; i < n; i = i + 1) tx[3 + i] = payload[i];
            spi(3 + n);
        end
    endtask
    task automatic read_mem(input [15:0] a, input integer n);   // result in rx[4..]
        integer i;
        begin
            tx[0] = 8'h0B; tx[1] = a[15:8]; tx[2] = a[7:0];
            for (i = 3; i < 4 + n; i = i + 1) tx[i] = 8'h00;
            spi(4 + n);
        end
    endtask
    function [15:0] rx16(input integer o); rx16 = {rx[4 + o + 1], rx[4 + o]}; endfunction
    function [31:0] rx32(input integer o); rx32 = {rx[4 + o + 3], rx[4 + o + 2], rx[4 + o + 1], rx[4 + o]}; endfunction

    task automatic ctrl(input [7:0] v);
        begin payload[0] = v; write_mem(16'h000C, 1); end
    endtask
    task automatic set_req_len(input [15:0] l);
        begin payload[0] = l[7:0]; payload[1] = l[15:8]; write_mem(16'h0010, 2); end
    endtask
    reg [15:0] st;
    task automatic status;
        begin read_mem(16'h0008, 2); st = rx16(0); end
    endtask

    task automatic check_ident(input expect_ok);
        begin
            read_mem(16'h0000, 8);
            if (expect_ok) begin
                if ({rx[4], rx[5], rx[6], rx[7]} !== "AMBX") fail("MAGIC");
                if (rx16(4) !== 16'h0003) fail("VERSION");
                if (rx16(6) !== 16'h000F) fail("CAPS");
            end else if ({rx[4], rx[5], rx[6], rx[7]} === "AMBX") fail("MAGIC visible while FPGA not ready");
        end
    endtask

    // ---------------- AJOB helpers ----------------
    reg [7:0] aq [0:8191];
    reg [7:0] ar [0:8191];
    reg [7:0] dumpb [0:8191];
    integer pj0, pi0;
    integer ab_k, ab_n, ab_rl, ab_t, ab_cyc;
    task automatic load_case(input integer k);
        begin
            case (k)
            0: begin $readmemh({AJOB_DIR, "/ajob_0_req.memh"}, aq); $readmemh({AJOB_DIR, "/ajob_0_resp.memh"}, ar); end
            1: begin $readmemh({AJOB_DIR, "/ajob_1_req.memh"}, aq); $readmemh({AJOB_DIR, "/ajob_1_resp.memh"}, ar); end
            2: begin $readmemh({AJOB_DIR, "/ajob_2_req.memh"}, aq); $readmemh({AJOB_DIR, "/ajob_2_resp.memh"}, ar); end
            3: begin $readmemh({AJOB_DIR, "/ajob_3_req.memh"}, aq); $readmemh({AJOB_DIR, "/ajob_3_resp.memh"}, ar); end
            4: begin $readmemh({AJOB_DIR, "/ajob_4_req.memh"}, aq); $readmemh({AJOB_DIR, "/ajob_4_resp.memh"}, ar); end
            5: begin $readmemh({AJOB_DIR, "/ajob_5_req.memh"}, aq); $readmemh({AJOB_DIR, "/ajob_5_resp.memh"}, ar); end
            6: begin $readmemh({AJOB_DIR, "/ajob_6_req.memh"}, aq); $readmemh({AJOB_DIR, "/ajob_6_resp.memh"}, ar); end
            7: begin $readmemh({AJOB_DIR, "/ajob_7_req.memh"}, aq); $readmemh({AJOB_DIR, "/ajob_7_resp.memh"}, ar); end
            8: begin $readmemh({AJOB_DIR, "/ajob_8_req.memh"}, aq); $readmemh({AJOB_DIR, "/ajob_8_resp.memh"}, ar); end
            9: begin $readmemh({AJOB_DIR, "/ajob_9_req.memh"}, aq); $readmemh({AJOB_DIR, "/ajob_9_resp.memh"}, ar); end
            default: begin $readmemh({AJOB_DIR, "/ajob_10_req.memh"}, aq); $readmemh({AJOB_DIR, "/ajob_10_resp.memh"}, ar); end
            endcase
        end
    endtask
    task automatic dump_case(input integer k, input integer n);
        integer fd, q;
        reg [8*128-1:0] fn;
        begin
            $sformat(fn, "%0s/ajob_%0d_rtl.memh", AJOB_DIR, k);
            fd = $fopen(fn, "w");
            for (q = 0; q < n; q = q + 1) $fdisplay(fd, "%02x", rx[4 + q]);
            $fclose(fd);
        end
    endtask
    // do_abort = 1: ring, then CONTROL.ABORT while the batch runs; expect status 5, count 0
    task automatic run_ajob(input integer k, input integer do_abort);
        integer q;
        begin
            load_case(k);
            ab_n = ajob_qlen(k);
            for (q = 0; q < ab_n; q = q + 1) payload[q] = aq[q];
            write_mem(16'h2000, ab_n);
            set_req_len(ab_n[15:0]);
            ctrl(8'h01);
            if (do_abort) begin
                repeat (3000) @(posedge sys_clk);
                ctrl(8'h40);
            end
            ab_t = 0; while (irq_n_pad !== 1'b0 && ab_t < 4000000) begin #100; ab_t = ab_t + 100; end
            if (irq_n_pad !== 1'b0) fail("AJOB: no IRQ");
            read_mem(16'h0014, 2); ab_rl = rx16(0);
            read_mem(16'h0024, 4); ab_cyc = rx32(0);
            if (do_abort) begin
                read_mem(16'h4000, 16);
                if ({rx[4], rx[5], rx[6], rx[7]} !== "ARES") fail("AJOB abort: magic");
                if (rx[9] !== 8'd5 || rx16(6) !== 16'd0 || ab_rl != 16) fail("AJOB abort: status/count/len");
                if (rx[12] !== aq[8] || rx[13] !== aq[9]) fail("AJOB abort: seq echo");
                $display("INFO ajob abort case=%0d status=%0d resp_len=%0d cycles=%0d", k, rx[9], ab_rl, ab_cyc);
            end else begin
                if (ab_rl != ajob_rlen(k)) fail("AJOB: RESP_LEN");
                read_mem(16'h4000, ajob_rlen(k));
                for (q = 0; q < ajob_rlen(k); q = q + 1) if (rx[4 + q] !== ar[q]) begin
                    $display("TB_ERROR ajob case %0d byte %0d rtl=%02x ref=%02x", k, q, rx[4 + q], ar[q]);
                    fail("AJOB: response differs from C reference"); q = ajob_rlen(k); end
                dump_case(k, ajob_rlen(k));
                $display("INFO ajob case=%0d req=%0d resp=%0d status=%0d cycles=%0d (%0d ns at 80 MHz)",
                         k, ab_n, ab_rl, ajob_status(k), ab_cyc, ab_cyc * 25 / 2);
            end
            ctrl(8'h02);
            #(20 * SYS_NS);
            if (irq_n_pad !== 1'b1) fail("AJOB: IRQ not released");
        end
    endtask

    // ---------------- sequence ----------------
    integer i, j, len, t, v_ok, seed = 5;
    reg [7:0] gold [0:8191];
    initial begin
        // FPGA not configured / PLL not locked: host must see "not ready"
        #200;
        check_ident(0);
        if (rx[4] !== 8'h00) fail("idle MISO should read the strap pull-down 0x00");
        psram.inject_dead = 1;
        pll_locked = 1;
        repeat (20) @(posedge sys_clk);
        check_ident(1);
        status;
        if (!st[0]) fail("FPGA_READY");
        if (st[1]) fail("PSRAM_READY before tPU");
        if (st[11]) fail("P0: POWER_ON while PSRAM unpowered");
        #20000; status;
        if (st[1] || st[11]) fail("P0: PSRAM reported while unpowered");
        $display("TEST ident done errors=%0d", errors);
        $display("TEST P0_unpowered_start done errors=%0d back_power_en_low=%0d", errors, bp_en_low);
        psram_on;
        $display("TEST P1_controlled_powerup started (tPU pins checked continuously)");

        // buffer integrity at SCK = sys/8 and sys/16
        for (j = 0; j < 2; j = j + 1) begin
            hp = (j == 0) ? 4 * SYS_NS : 8 * SYS_NS;
            for (i = 0; i < 4120; i = i + 1) payload[i] = $random(seed);
            write_mem(16'h2000, 4120);
            read_mem(16'h2000, 4120);
            for (i = 0; i < 4120; i = i + 1) if (rx[4 + i] !== payload[i]) begin
                fail("REQ buffer readback"); i = 4120; end
        end
        hp = 4 * SYS_NS;
        $display("TEST buffer_integrity done errors=%0d", errors);

        // CS# abort mid-byte: only complete bytes are written, slave resynchronises
        payload[0] = 8'hA1; payload[1] = 8'hB2; write_mem(16'h2100, 2);
        tx[0] = 8'h02; tx[1] = 8'h21; tx[2] = 8'h00; tx[3] = 8'h5A;
        ss_n = 0; #(2 * hp);
        for (i = 0; i < 4 * 8 + 5; i = i + 1) begin      // 4 bytes + 5 bits
            mosi = (i < 32) ? tx[i / 8][7 - (i % 8)] : 1'b1;
            #(hp); sck = 1; #(hp); sck = 0;
        end
        #(2 * hp); ss_n = 1; #(4 * hp);
        read_mem(16'h2100, 2);
        if (rx[4] !== 8'h5A || rx[5] !== 8'hB2) fail("partial-byte abort handling");
        check_ident(1);
        $display("TEST cs_abort done errors=%0d", errors);

        // R05 golden wire frames through the transport loopback, byte-exact
        for (j = 0; j < NGOLD; j = j + 1) begin
            len = golden_len(j);
            case (j)
            0: $readmemh({GOLD_DIR, "/golden_0.memh"}, gold, 0, len - 1);
            1: $readmemh({GOLD_DIR, "/golden_1.memh"}, gold, 0, len - 1);
            2: $readmemh({GOLD_DIR, "/golden_2.memh"}, gold, 0, len - 1);
            3: $readmemh({GOLD_DIR, "/golden_3.memh"}, gold, 0, len - 1);
            default: $readmemh({GOLD_DIR, "/golden_4.memh"}, gold, 0, len - 1);
            endcase
            for (i = 0; i < len; i = i + 1) payload[i] = gold[i];
            write_mem(16'h2000, len);
            set_req_len(len);
            ctrl(8'h01);                                   // doorbell
            t = 0; while (irq_n_pad !== 1'b0 && t < 100000) begin #100; t = t + 100; end
            if (irq_n_pad !== 1'b0) fail("no IRQ after doorbell");
            status;
            if (!st[4] || st[3]) fail("RESP_READY/JOB_PENDING state");
            read_mem(16'h0014, 2);
            if (rx16(0) !== len) fail("RESP_LEN");
            read_mem(16'h4000, len);
            for (i = 0; i < len; i = i + 1) if (rx[4 + i] !== gold[i]) begin
                fail("golden frame altered by mailbox"); i = len; end
            ctrl(8'h02);                                   // RESP_ACK
            #(20 * SYS_NS);
            if (irq_n_pad !== 1'b1) fail("IRQ not released after RESP_ACK");
            $display("INFO golden frame %0d len=%0d passed through unchanged", j, len);
        end
        read_mem(16'h0018, 4);
        if (rx32(0) !== NGOLD) fail("DOORBELLS count");
        $display("TEST golden_loopback done errors=%0d", errors);

        // doorbell overrun / invalid length
        set_req_len(16); ctrl(8'h01); ctrl(8'h01);         // second ring while busy/resp pending
        status; if (!st[5]) fail("DOORBELL_OVERRUN not flagged");
        ctrl(8'h02); ctrl(8'h10);
        status; if (st[5]) fail("overrun not cleared");
        set_req_len(0); ctrl(8'h01);
        status; if (!st[5]) fail("zero-length doorbell accepted");
        ctrl(8'h10);
        $display("TEST doorbell_rules done errors=%0d", errors);

        // ---------- R8.5 AJOB cross-simulation (C driver frames vs RTL) ----------
        read_mem(16'h0028, 4); pj0 = rx32(0);
        read_mem(16'h002C, 4); pi0 = rx32(0);
        for (j = 0; j < NAJOB; j = j + 1) begin
            run_ajob(j, 0);
            if (ajob_status(j) >= 0) begin
                read_mem(16'h0030, 1);
                if (rx[4] !== ajob_status(j)) fail("LAST_STATUS register");
            end
        end
        read_mem(16'h0028, 4); if (rx32(0) - pj0 != NAJOB) fail("PERF_JOBS");
        read_mem(16'h002C, 4); if (rx32(0) - pi0 != 1 + 8 + 170 + 16) fail("PERF_ITEMS");
        $display("TEST ajob_crosssim done errors=%0d", errors);
        // ABORT in the middle of the 170-job batch
        run_ajob(2, 1);
        $display("TEST ajob_abort done errors=%0d", errors);
        // the engine is usable again after an abort
        run_ajob(0, 0);
        $display("TEST ajob_after_abort done errors=%0d", errors);

        // PSRAM ready + BIST pass
        t = 0; status;
        while (!st[1] && t < 400) begin #1000; t = t + 1; status; end
        if (!st[1]) fail("PSRAM_READY never set");
        if (st[2]) fail("PSRAM_ERROR set");
        ctrl(8'h08);
        t = 0; status;
        while (st[6] || (!st[7] && !st[8])) begin #20000; t = t + 1; status; if (t > 2000) begin fail("BIST hang"); st = 16'h0080; end end
        read_mem(16'h001C, 4);
        if (!st[7] || st[8] || rx32(0) != 0) fail("BIST should pass");
        $display("INFO bist pass=%0d fail=%0d errs=%0d", st[7], st[8], rx32(0));
        $display("TEST psram_bist_pass done errors=%0d", errors);

        // BIST must detect a corrupted byte (written block, before its read-back)
        ctrl(8'h08);
        wait (dut.u_bist.phase_read === 1'b1);
        psram.mem[23'h003F05] = ~psram.mem[23'h003F05];   // block 63, read last
        t = 0; status;
        while (st[6] || (!st[7] && !st[8])) begin #20000; t = t + 1; status; if (t > 2000) begin fail("BIST hang"); st = 16'h0100; end end
        read_mem(16'h001C, 4);
        if (!st[8] || st[7] || rx32(0) != 1) fail("BIST should report exactly one error");
        $display("INFO bist-with-fault pass=%0d fail=%0d errs=%0d", st[7], st[8], rx32(0));
        $display("TEST psram_bist_detects_fault done errors=%0d", errors);

        // PSRAM recover command
        ctrl(8'h04);
        #5000; status;
        t = 0; while (!st[1] && t < 100) begin #1000; t = t + 1; status; end
        if (!st[1]) fail("PSRAM not ready after recover");
        $display("TEST psram_recover done errors=%0d", errors);

        // FPGA reset in the middle of a job: host sees NOT ready, then a clean state
        for (i = 0; i < 64; i = i + 1) payload[i] = i;
        write_mem(16'h2000, 64); set_req_len(64);
        ss_n = 0; #(2 * hp);                               // start a doorbell write ...
        pll_locked = 0;                                    // ... and lose the FPGA
        #(40 * hp); ss_n = 1; #(4 * hp);
        check_ident(0);
        pll_locked = 1; repeat (20) @(posedge sys_clk);
        check_ident(1);
        status;
        if (st[3] || st[4] || st[5]) fail("stale job state after FPGA reset");
        t = 0; status; while (!st[1] && t < 400) begin #1000; t = t + 1; status; end
        read_mem(16'h0018, 4); if (rx32(0) != 0) fail("doorbell counter not reset");
        $display("TEST fpga_reset done errors=%0d", errors);

        status; if (!st[11] || st[12]) fail("P1: power state after power-up");
        read_mem(16'h0020, 1); if (rx[4] !== 8'd1) fail("P1: EPOCH should be 1");
        $display("TEST P1_controlled_powerup done errors=%0d tpu_pin_viol=%0d", errors, tpu_pin_viol);
        v_ok = psram.violations;

        // ---------- P2 commanded power-off during BIST ----------
        ctrl(8'h08);
        wait (dut.u_bist.phase_read === 1'b1);
        psram_off_commanded;
        t = 0; status;
        while (st[6] && t < 2000) begin #20000; t = t + 1; status; end
        if (st[6]) fail("P2: BIST hangs after power loss");
        if (st[7] && !st[8]) fail("P2: BIST passed across a power loss");
        if (st[11] || !st[12] || st[1]) fail("P2: POWER_ON/POWER_LOST/READY after power-off");
        psram_on;
        t = 0; status; while (!dut.ram_ready && t < 400) begin #1000; t = t + 1; end
        if (!dut.ram_ready) fail("P2: controller did not re-initialise");
        status; if (st[1]) fail("P2: READY reported before host cleared POWER_LOST");
        read_mem(16'h0020, 1); if (rx[4] !== 8'd2) fail("P2: EPOCH should be 2");
        ctrl(8'h20); status;
        if (st[12] || !st[1]) fail("P2: CLEAR_POWER_LOST");
        ctrl(8'h08); t = 0; status;
        while (st[6] || (!st[7] && !st[8])) begin #20000; t = t + 1; status; if (t > 2000) begin fail("BIST hang"); st = 16'h0100; end end
        if (!st[7] || st[8]) fail("P2: BIST after re-power should pass");
        $display("TEST P2_commanded_poweroff done errors=%0d back_power_en_low=%0d", errors, bp_en_low);

        // ---------- P3 PG glitch ----------
        @(posedge sys_clk); pg_glitch_n = 0; @(posedge sys_clk); pg_glitch_n = 1;
        #5000; status;
        if (!st[12]) fail("P3: PG glitch not reported as POWER_LOST");
        t = 0; while (!dut.ram_ready && t < 400) begin #1000; t = t + 1; end
        ctrl(8'h20); status;
        if (!st[1]) fail("P3: not ready after glitch + clear");
        read_mem(16'h0020, 1); if (rx[4] !== 8'd3) fail("P3: EPOCH should be 3");
        $display("TEST P3_pg_glitch done errors=%0d", errors);

        // ---------- P4 unannounced rail loss (EN still high) ----------
        ctrl(8'h08);
        wait (dut.u_bist.phase_read === 1'b1);
        vdd = 0; psram.inject_dead = 1; #2000; pg = 0;      // supervisor detection delay 2 us (assumed)
        t = 0; status;
        while (st[6] && t < 2000) begin #20000; t = t + 1; status; end
        if (!st[12] || st[1]) fail("P4: rail loss not reported");
        $display("INFO P4 back-power window before PG detection: %0d ns total (EN high; residual risk, see PSRAM_POWER_R08.md)", bp_en_high_ns);
        en = 0; #1000; psram_on;
        t = 0; while (!dut.ram_ready && t < 400) begin #1000; t = t + 1; end
        ctrl(8'h20); status; if (!st[1]) fail("P4: no recovery");
        $display("TEST P4_unannounced_loss done errors=%0d", errors);

        // ---------- F06: QSPI CE# stuck active (external short to GND), RTL view ----------
        ce_stuck_inj = 1'b1;
        force ce_pad = 1'b0;
        ctrl(8'h04);                                        // PSRAM_RECOVER: re-run the init sequence
        t = 0; status; while (!st[1] && !st[2] && t < 400) begin #1000; t = t + 1; status; end
        ctrl(8'h08);
        t = 0; status;
        while (st[6] || (!st[7] && !st[8] && !st[2])) begin #20000; t = t + 1; status; if (t > 2000) begin fail("F06 BIST hang"); st = 16'h0100; end end
        read_mem(16'h001C, 4);
        $display("INFO F06 CE# stuck: STATUS=%h ready=%0d error=%0d bist_pass=%0d bist_fail=%0d bist_errs=%0d contention_events=%0d",
                 st, st[1], st[2], st[7], st[8], rx32(0), contention_during_inj);
        if (st[7] && !st[8] && !st[2]) fail("F06: CE# stuck not detected (BIST passed)");
        release ce_pad;
        #2000;
        ce_stuck_inj = 1'b0;
        ctrl(8'h04);
        t = 0; status; while (!st[1] && t < 400) begin #1000; t = t + 1; status; end
        ctrl(8'h08); t = 0; status;
        while (st[6] || (!st[7] && !st[8])) begin #20000; t = t + 1; status; if (t > 2000) begin fail("BIST hang"); st = 16'h0100; end end
        if (!st[7] || st[8]) fail("F06: no recovery after the short is removed");
        $display("TEST F06_ce_stuck done errors=%0d", errors);

        if (bp_en_low != 0) fail("back-power while EN low");
        if (tpu_pin_viol != 0) fail("tPU pin-state violations");
        $display("SUMMARY tb_ecp5_top errors=%0d model_violations_before_P2=%0d total=%0d tpu_pin_viol=%0d back_power_en_low=%0d",
                 errors, v_ok, psram.violations, tpu_pin_viol, bp_en_low);
        if (errors == 0 && v_ok == 0) $display("TOP_ECP5_TB_PASS"); else $display("TOP_ECP5_TB_FAIL");
        $finish;
    end
    initial begin #200_000_000; $display("TOP_TB_FAIL global timeout"); $finish; end
endmodule
